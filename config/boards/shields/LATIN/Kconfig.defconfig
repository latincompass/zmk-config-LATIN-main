## config/boards/shields/LATIN/Kconfig.defconfig
```kconfig
# Copyright (c) 2022 The ZMK Contributors
# SPDX-License-Identifier: MIT

if SHIELD_LATIN

config ZMK_KEYBOARD_NAME
    default "Latin-Xiao_ble"
    
endif
```

## config/boards/shields/LATIN/Kconfig.shield
```kconfig
# Copyright (c) 2022 The ZMK Contributors
# SPDX-License-Identifier: MIT

config SHIELD_LATIN
    def_bool $(shields_list_contains,LATIN)
```
